## conf/layer.conf
```bitbake
# We have a conf and classes directory, add to BBPATH
BBPATH .= ":${LAYERDIR}"

# We have recipes-* directories, add to BBFILES
BBFILES += "${LAYERDIR}/recipes-*/*/*.bb \
            ${LAYERDIR}/recipes-*/*/*.bbappend"

BBFILE_COLLECTIONS += "meta-yapps"
BBFILE_PATTERN_meta-yapps = "^${LAYERDIR}/"
BBFILE_PRIORITY_meta-yapps = "6"

LAYERDEPENDS_meta-yapps = "core"
LAYERSERIES_COMPAT_meta-yapps = "scarthgap"
```
